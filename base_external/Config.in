## base_external/Config.in
```kconfig
source "$BR2_EXTERNAL_project_base_PATH/package/aesd-assignments/Config.in"
source "$BR2_EXTERNAL_project_base_PATH/package/aesd-assignment5part2/Config.in"
```

## base_external/package/aesd-assignment5part2/Config.in
```kconfig
config BR2_PACKAGE_AESD_ASSIGNMENT5PART2
	bool "aesd-assignment5part2"
	help
	  Includes the aesdsocket executable, aesdsocket-start-stop in the kernel image.
	  Used to understand buildroot external trees and package builds.
```
